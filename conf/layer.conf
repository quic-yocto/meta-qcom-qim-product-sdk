## conf/layer.conf
```bitbake
BBFILES += "${LAYERDIR}/recipes-*/*/*.bb \
            ${LAYERDIR}/recipes-*/*/*.bbappend"
BBPATH .= ":${LAYERDIR}"
BBFILE_COLLECTIONS += "qcom-qim-product-sdk"
BBFILE_PATTERN_qcom-qim-product-sdk := "^${LAYERDIR}/"
BBFILE_PRIORITY_qcom-qim-product-sdk = "17"
LAYERSERIES_COMPAT_qcom-qim-product-sdk = "kirkstone"

# do not error out on bbappends for missing recipes
BB_DANGLINGAPPENDS_WARNONLY = "true"

PACKAGECONFIG-pn_tensorflow-lite = "gpu"

HEXAGON_VERSION = "v68"
SNPE_VERSION = "2.18.0.240101"
QNN_VERSION = "2.19.0.240124"

# add packagegroup-qcom-qim-product to the base image
CORE_IMAGE_EXTRA_INSTALL += "packagegroup-qcom-qim-product"
```
